// SPDX-License-Identifier: (GPL-2.0+ OR MIT)
/*
 * Minimal overlay for HH300 MMC5983 gyro sensor
 */
/dts-v1/;
/plugin/;

&i2c0 {
	#address-cells = <1>;
	#size-cells = <0>;

	gyro@1e {
		status = "disabled";
	};

	mmc@30 {
		compatible = "memsic,mmc5983";
		reg = <0x30>;
		status = "okay";
	};
};
